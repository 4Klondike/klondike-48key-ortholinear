## boards/shields/klondike-48key-ortholinear/Kconfig.defconfig
```kconfig
if SHIELD_KLONDIKE48KORT

# Name must be less than 16 characters long!
config ZMK_KEYBOARD_NAME
    default "Klondike48kort"

endif
```

## boards/shields/klondike-48key-ortholinear/Kconfig.shield
```kconfig
# No whitespace after the comma or in your keyboard name!
config SHIELD_KLONDIKE48KORT
    def_bool $(shields_list_contains,klondike48kort)
```

## west.yml
```yaml
manifest:
  remotes:
    - name: klondike-48key-ortholinear
      url-base: https://github.com/4Klondike/klondike-48key-ortholinear
  projects:
    # Together with the above defined remote, this refers to a module located at
    # https://github.com/remote-name/repository-name
    - name: klondike-48key-ortholinear
      remote: klondike-48key-ortholinear
      # This points to a west manifest file in the remote module for further imports
      import: west.yml
```
